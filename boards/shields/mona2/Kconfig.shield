## boards/shields/mona2/Kconfig.shield
```kconfig
config SHIELD_MONA2_R
    def_bool $(shields_list_contains,mona2_r)

config SHIELD_MONA2_L
    def_bool $(shields_list_contains,mona2_l)

config SHIELD_MONA2_DEBUG_NO_TRACKBALL
    def_bool $(shields_list_contains,mona2_debug_no_trackball)
```
